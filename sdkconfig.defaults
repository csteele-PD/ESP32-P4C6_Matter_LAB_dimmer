## sdkconfig.defaults
```kconfig
CONFIG_IDF_TARGET="esp32p4"
CONFIG_ESP32P4_SELECTS_REV_LESS_V3=y
CONFIG_ESP32P4_REV_MIN_100=y
CONFIG_ESP_DEFAULT_CPU_FREQ_MHZ_360=y

CONFIG_ESPTOOLPY_FLASHSIZE_32MB=y
CONFIG_ESPTOOLPY_FLASHMODE_QIO=y
CONFIG_ESPTOOLPY_FLASHFREQ_80M=y

CONFIG_PARTITION_TABLE_CUSTOM=y
CONFIG_PARTITION_TABLE_CUSTOM_FILENAME="partitions.csv"
CONFIG_PARTITION_TABLE_OFFSET=0x10000

CONFIG_SPIRAM=y

# Keep Matter's larger heaps out of scarce internal RAM on P4 boards with PSRAM.
# CONFIG_CHIP_MEM_ALLOC_MODE_DEFAULT is not set
CONFIG_CHIP_MEM_ALLOC_MODE_EXTERNAL=y
CONFIG_CHIP_TASK_STACK_SIZE=12288
# CONFIG_ESP_MATTER_MEM_ALLOC_MODE_DEFAULT is not set
CONFIG_ESP_MATTER_MEM_ALLOC_MODE_EXTERNAL=y

# P4 has no native Wi-Fi. The C6 coprocessor is reached through ESP-Hosted SDIO.
CONFIG_ESP_HOSTED_ENABLED=y
CONFIG_SLAVE_IDF_TARGET_ESP32C6=y
CONFIG_ESP_HOSTED_IDF_SLAVE_TARGET="esp32c6"
CONFIG_ESP_HOSTED_P4_DEV_BOARD_NONE=y
CONFIG_ESP_HOSTED_SDIO_HOST_INTERFACE=y
CONFIG_ESP_HOSTED_SDIO_RESET_ACTIVE_HIGH=y
CONFIG_ESP_HOSTED_SDIO_OPTIMIZATION_RX_STREAMING_MODE=y
CONFIG_ESP_HOSTED_SDIO_SLOT_1=y
CONFIG_ESP_HOSTED_SDIO_SLOT=1
CONFIG_ESP_HOSTED_SDIO_4_BIT_BUS=y
CONFIG_ESP_HOSTED_SDIO_BUS_WIDTH=4
CONFIG_ESP_HOSTED_SDIO_CLOCK_FREQ_KHZ=20000
CONFIG_ESP_HOSTED_SDIO_GPIO_RESET_SLAVE=54
CONFIG_ESP_HOSTED_GPIO_SLAVE_RESET_SLAVE=54
CONFIG_ESP_HOSTED_SDIO_PIN_CMD=19
CONFIG_ESP_HOSTED_SDIO_PIN_CLK=18
CONFIG_ESP_HOSTED_SDIO_PIN_D0=14
CONFIG_ESP_HOSTED_SDIO_PIN_D1=15
CONFIG_ESP_HOSTED_SDIO_PIN_D2=16
CONFIG_ESP_HOSTED_SDIO_PIN_D3=17
CONFIG_ESP_HOSTED_SLAVE_RESET_ON_EVERY_HOST_BOOTUP=y
CONFIG_ESP_HOSTED_USE_MEMPOOL=y
CONFIG_ESP_WIFI_REMOTE_ENABLED=y
CONFIG_ESP_WIFI_REMOTE_LIBRARY_HOSTED=y
CONFIG_LWIP_TCP_SND_BUF_DEFAULT=65534
CONFIG_LWIP_TCP_WND_DEFAULT=65534
CONFIG_LWIP_TCP_RECVMBOX_SIZE=64
CONFIG_LWIP_UDP_RECVMBOX_SIZE=64
CONFIG_LWIP_TCPIP_RECVMBOX_SIZE=64
CONFIG_LWIP_TCP_SACK_OUT=y

# Matter lab identity/providers.
# CONFIG_ESP_MATTER_ENABLE_OPENTHREAD is not set
# CONFIG_ENABLE_ESP32_FACTORY_DATA_PROVIDER is not set
# CONFIG_ENABLE_ESP32_DEVICE_INSTANCE_INFO_PROVIDER is not set
CONFIG_EXAMPLE_DAC_PROVIDER=y
CONFIG_EXAMPLE_COMMISSIONABLE_DATA_PROVIDER=y
# CONFIG_EXAMPLE_DEVICE_INSTANCE_INFO_PROVIDER is not set
CONFIG_CUSTOM_DEVICE_INSTANCE_INFO_PROVIDER=y

CONFIG_DEVICE_VENDOR_ID=0xFFF1
CONFIG_DEVICE_PRODUCT_ID=0x8002

CONFIG_ENABLE_TEST_SETUP_PARAMS=y
CONFIG_CHIP_ENABLE_PAIRING_AUTOSTART=y
CONFIG_ENABLE_WIFI_STATION=y

# CONFIG_ENABLE_OTA_REQUESTOR is not set
# CONFIG_ENABLE_CHIP_SHELL is not set
# CONFIG_ENABLE_SNTP_TIME_SYNC is not set
```
